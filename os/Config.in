## os/Config.in
```kconfig
source "$BR2_EXTERNAL_ILRDOS_PATH/package/ilrdos/Config.in"
source "$BR2_EXTERNAL_ILRDOS_PATH/package/ilrdos-vosk/Config.in"
```

## os/package/ilrdos-vosk/Config.in
```kconfig
config BR2_PACKAGE_ILRDOS_VOSK
	bool "ilrdos-vosk"
	depends on BR2_aarch64
	depends on BR2_INSTALL_LIBSTDCPP
	depends on BR2_TOOLCHAIN_USES_GLIBC
	help
	  libvosk pré-compilada (aarch64) e modelo Vosk pequeno de português
	  brasileiro, baixados do projeto Vosk durante a build.

comment "ilrdos-vosk needs aarch64, glibc and a toolchain w/ C++"
	depends on !BR2_aarch64 || !BR2_INSTALL_LIBSTDCPP || !BR2_TOOLCHAIN_USES_GLIBC
```

## os/package/ilrdos/Config.in
```kconfig
config BR2_PACKAGE_ILRDOS
	bool "ilrdos"
	depends on BR2_INSTALL_LIBSTDCPP
	depends on BR2_TOOLCHAIN_HAS_THREADS
	select BR2_PACKAGE_ALSA_LIB
	help
	  Runtime do robô ILrDOS: daemon de controle (GPIO, visão e
	  reconhecimento de rostos, voz, locomoção, IoT, autonomia e
	  console Wi-Fi autenticado por HMAC-SHA256).

comment "ilrdos needs a toolchain w/ C++, threads"
	depends on !BR2_INSTALL_LIBSTDCPP || !BR2_TOOLCHAIN_HAS_THREADS
```
